## board/engicam/imx8mm_icore/Kconfig
```kconfig
if TARGET_IMX8MM_ICORE

config SYS_BOARD
	default "imx8mm_icore"

config SYS_VENDOR
	default "engicam"

config SYS_CONFIG_NAME
	default "imx8mm_icore"

source "board/freescale/common/Kconfig"

endif
```

## board/engicam/imx8mp_icore/Kconfig
```kconfig
if TARGET_IMX8MP_ICORE

config SYS_BOARD
	default "imx8mp_icore"

config SYS_VENDOR
	default "engicam"

config SYS_CONFIG_NAME
	default "imx8mp_icore"

source "board/freescale/common/Kconfig"

endif
```
